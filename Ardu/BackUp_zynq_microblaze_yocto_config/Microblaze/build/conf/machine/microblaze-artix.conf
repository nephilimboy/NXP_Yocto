## kr260/build/conf/bblayers.conf
```bitbake
BBPATH = "${TOPDIR}"
BBFILES ?= ""

BBLAYERS ?= " \
  /home/tsndetnet/Documents/AmirWorkSpace/YoctoKR260/sources/poky/meta \
  /home/tsndetnet/Documents/AmirWorkSpace/YoctoKR260/sources/poky/meta-poky \
  /home/tsndetnet/Documents/AmirWorkSpace/YoctoKR260/sources/poky/../meta-xilinx/meta-microblaze \
  /home/tsndetnet/Documents/AmirWorkSpace/YoctoKR260/sources/poky/../meta-xilinx/meta-xilinx-core \
  /home/tsndetnet/Documents/AmirWorkSpace/YoctoKR260/sources/poky/../meta-xilinx/meta-xilinx-standalone \
  /home/tsndetnet/Documents/AmirWorkSpace/YoctoKR260/sources/poky/../meta-xilinx/meta-xilinx-standalone-sdt \
  /home/tsndetnet/Documents/AmirWorkSpace/YoctoKR260/sources/poky/../meta-xilinx/meta-xilinx-bsp \
  /home/tsndetnet/Documents/AmirWorkSpace/YoctoKR260/sources/poky/../meta-xilinx/meta-xilinx-vendor \
  /home/tsndetnet/Documents/AmirWorkSpace/YoctoKR260/sources/poky/../meta-xilinx/meta-xilinx-virtualization \
  /home/tsndetnet/Documents/AmirWorkSpace/YoctoKR260/sources/poky/../meta-xilinx/meta-xilinx-mali400 \
  /home/tsndetnet/Documents/AmirWorkSpace/YoctoKR260/sources/poky/../meta-xilinx/meta-xilinx-demos \
  /home/tsndetnet/Documents/AmirWorkSpace/YoctoKR260/sources/poky/../meta-xilinx/meta-xilinx-multimedia \
  /home/tsndetnet/Documents/AmirWorkSpace/YoctoKR260/sources/poky/../meta-xilinx-tools \
  /home/tsndetnet/Documents/AmirWorkSpace/YoctoKR260/sources/poky/../meta-amd-adaptive-socs/meta-amd-adaptive-socs-core \
  /home/tsndetnet/Documents/AmirWorkSpace/YoctoKR260/sources/poky/../meta-amd-adaptive-socs/meta-amd-adaptive-socs-bsp \
  /home/tsndetnet/Documents/AmirWorkSpace/YoctoKR260/sources/poky/../meta-arm/meta-arm \
  /home/tsndetnet/Documents/AmirWorkSpace/YoctoKR260/sources/poky/../meta-arm/meta-arm-toolchain \
  /home/tsndetnet/Documents/AmirWorkSpace/YoctoKR260/sources/poky/../meta-openembedded/meta-perl \
  /home/tsndetnet/Documents/AmirWorkSpace/YoctoKR260/sources/poky/../meta-openembedded/meta-python \
  /home/tsndetnet/Documents/AmirWorkSpace/YoctoKR260/sources/poky/../meta-openembedded/meta-filesystems \
  /home/tsndetnet/Documents/AmirWorkSpace/YoctoKR260/sources/poky/../meta-openembedded/meta-gnome \
  /home/tsndetnet/Documents/AmirWorkSpace/YoctoKR260/sources/poky/../meta-openembedded/meta-multimedia \
  /home/tsndetnet/Documents/AmirWorkSpace/YoctoKR260/sources/poky/../meta-openembedded/meta-networking \
  /home/tsndetnet/Documents/AmirWorkSpace/YoctoKR260/sources/poky/../meta-openembedded/meta-webserver \
  /home/tsndetnet/Documents/AmirWorkSpace/YoctoKR260/sources/poky/../meta-openembedded/meta-xfce \
  /home/tsndetnet/Documents/AmirWorkSpace/YoctoKR260/sources/poky/../meta-openembedded/meta-initramfs \
  /home/tsndetnet/Documents/AmirWorkSpace/YoctoKR260/sources/poky/../meta-openembedded/meta-oe \
  /home/tsndetnet/Documents/AmirWorkSpace/YoctoKR260/sources/poky/../meta-xilinx/meta-xilinx-contrib \
  /home/tsndetnet/Documents/AmirWorkSpace/YoctoKR260/sources/poky/../meta-virtualization \
  /home/tsndetnet/Documents/AmirWorkSpace/YoctoKR260/sources/poky/../meta-kria \
  /home/tsndetnet/Documents/AmirWorkSpace/YoctoKR260/sources/poky/../meta-embedded-plus \
  /home/tsndetnet/Documents/AmirWorkSpace/YoctoKR260/sources/poky/../meta-security \
  /home/tsndetnet/Documents/AmirWorkSpace/YoctoKR260/sources/poky/../meta-security/meta-tpm \
  /home/tsndetnet/Documents/AmirWorkSpace/YoctoKR260/sources/poky/../meta-xilinx-tsn \
  /home/tsndetnet/Documents/AmirWorkSpace/YoctoKR260/sources/poky/../meta-petalinux \
  /home/tsndetnet/Documents/AmirWorkSpace/YoctoKR260/sources/poky/../meta-openamp \
  /home/tsndetnet/Documents/AmirWorkSpace/YoctoKR260/sources/poky/../meta-qt5 \
  /home/tsndetnet/Documents/AmirWorkSpace/YoctoKR260/sources/poky/../meta-aws \
  /home/tsndetnet/Documents/AmirWorkSpace/YoctoKR260/sources/poky/../meta-jupyter \
  /home/tsndetnet/Documents/AmirWorkSpace/YoctoKR260/sources/poky/../meta-rauc \
  /home/tsndetnet/Documents/AmirWorkSpace/YoctoKR260/sources/poky/../meta-system-controller \
  /home/tsndetnet/Documents/AmirWorkSpace/YoctoKR260/sources/poky/../meta-ros/meta-ros-common \
  /home/tsndetnet/Documents/AmirWorkSpace/YoctoKR260/sources/poky/../meta-ros/meta-ros2 \
  /home/tsndetnet/Documents/AmirWorkSpace/YoctoKR260/sources/poky/../meta-ros/meta-ros2-jazzy \
  /home/tsndetnet/Documents/AmirWorkSpace/YoctoKR260/sources/meta-srsRAN \
  "
```

## kr260/build/conf/local.conf
```bitbake
#
# Machine Selection
#
# You need to select a specific machine to target the build with. There are a selection
# of emulated machines available which can boot and run in the QEMU emulator:
#
#MACHINE ?= "microblaze-generic"
#MACHINE ?= "zynq-generic"
#MACHINE ?= "zynqmp-generic"
#MACHINE ?= "versal-generic"
#MACHINE ?= "versal-net-generic"
#
# There are also the following hardware board target machines included for 
# demonstration purposes:
#
#MACHINE ?= "k26-sm"
#MACHINE ?= "k26-smk"
#MACHINE ?= "k26-smk-kv"


MACHINE ?= "k26-smk-kr"


#
# This sets the default machine to be qemux86-64 if no other machine is selected:
#MACHINE ??= "zynqmp-generic"

DISTRO ?= "petalinux"

PACKAGE_CLASSES ?= "package_rpm"

USER_CLASSES ?= "buildstats"

# Create license (-lic) packages
LICENSE_CREATE_PACKAGE = "1"
COPY_LIC_MANIFEST = "1"

# URI's to check for connectivity from the sanity.bbclass
CONNECTIVITY_CHECK_URIS ?= ""

# Should mirror tarballs be generated during the do_fetch stage?
BB_GENERATE_MIRROR_TARBALLS ?= "1"

PATCHRESOLVE = "noop"

BB_DISKMON_DIRS ??= "\
    STOPTASKS,${TMPDIR},1G,100K \
    STOPTASKS,${DL_DIR},1G,100K \
    STOPTASKS,${SSTATE_DIR},1G,100K \
    STOPTASKS,/tmp,100M,100K \
    HALT,${TMPDIR},100M,1K \
    HALT,${DL_DIR},100M,1K \
    HALT,${SSTATE_DIR},100M,1K \
    HALT,/tmp,10M,1K"

PACKAGECONFIG:append:pn-qemu-system-native = " sdl"
# No shared hash equivalencey server, so default to Basic hash
BB_HASHSERVE = ""
BB_SIGNATURE_HANDLER = "OEBasicHash"

PRSERV_HOST = "localhost:0"

# This is a list of packages that may require a commercial license to ship
# product. It is your responsibility to read, understand and meet the
# licensing terms for all software used, however these are highlighted as
# they may have additional implications for commercial use.  To enable them,
# un-comment the below as appropriate.
LICENSE_FLAGS_ACCEPTED = " \
        commercial_${MLPREFIX}ffmpeg \
        commercial_${MLPREFIX}x264 \
        commercial_${MLPREFIX}gstreamer1.0-omx \
        commercial_${MLPREFIX}libomxil \
        commercial_${MLPREFIX}sox \
        commercial_${MLPREFIX}faac \
        commercial_${MLPREFIX}faad2 \
        xilinx "

#
# this doesn't mean anything to you.
CONF_VERSION = "2"

# Disable various layer sanity warnings that don't apply to our configuration(s)
SKIP_META_XILINX_MALI400_SANITY_CHECK = "1"
SKIP_META_XILINX_STANDALONE_SANITY_CHECK = "1"
SKIP_META_XILINX_STANDALONE_SDT_SANITY_CHECK = "1"
SKIP_META_XILINX_TOOLS_SANITY_CHECK = "1"
SKIP_META_VIRT_SANITY_CHECK = "1"
SKIP_META_SECURITY_SANITY_CHECK = "1"
SKIP_META_TPM_SANITY_CHECK = "1"
SKIP_META_GNOME_SANITY_CHECK = "1"
SKIP_META_RAUC_FEATURE_CHECK = "1"


MACHINE_FEATURES:append = " vcu"
# Fix error of Authentication token manipulation error
# On Changing password on the first login
EXTRA_IMAGE_FEATURES += "allow-root-login empty-root-password"

IMAGE_INSTALL:append = " srsran net-tools nano iproute2 openssh-sshd openssh-sftp-server"
IMAGE_FEATURES:append = " ssh-server-openssh"
```

## kr260/meta-srsRAN/conf/layer.conf
```bitbake
# We have a conf and classes directory, add to BBPATH
BBPATH .= ":${LAYERDIR}"

# We have recipes-* directories, add to BBFILES
BBFILES += "${LAYERDIR}/recipes-*/*/*.bb \
            ${LAYERDIR}/recipes-*/*/*.bbappend"

BBFILE_COLLECTIONS += "meta-srsRAN"
BBFILE_PATTERN_meta-srsRAN = "^${LAYERDIR}/"
BBFILE_PRIORITY_meta-srsRAN = "6"

LAYERDEPENDS_meta-srsRAN = "core"
LAYERSERIES_COMPAT_meta-srsRAN = "scarthgap"
```
