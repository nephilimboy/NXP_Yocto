## Ardu/BackUp_zynq_microblaze_yocto_config/Microblaze/build/conf/machine/microblaze-artix.conf
```bitbake
#@TYPE: Machine
#@NAME: microblaze-artix
#@DESCRIPTION: Machine configuration for the microblaze-artix boards.

#### Preamble
MACHINEOVERRIDES =. "${@['', 'microblaze-artix:']['microblaze-artix' !='${MACHINE}']}"
#### Regular settings follow

# MicroBlaze Tune features Settings
TUNE_FEATURES:tune-microblaze ?= "microblaze v11.0 pattern-compare barrel-shift divide-hard multiply-high fpu-hard reorder"
DEFAULTTUNE ?= "microblaze"

# Yocto device-tree variables
YAML_CONSOLE_DEVICE_CONFIG:pn-device-tree ?= "axi_uartlite_0"
YAML_MAIN_MEMORY_CONFIG:pn-device-tree ?= "mig_7series_0"
DT_PADDING_SIZE:pn-device-tree ?= "0x1000"
DTC_FLAGS:pn-device-tree ?= ""
XSCTH_PROC:pn-device-tree ?= "microblaze_0"
YAML_DT_BOARD_FLAGS ?= "{BOARD template}"

# Yocto u-boot-xlnx variables
UBOOT_MACHINE ?= "microblaze-generic_defconfig"

# Yocto FS-Boot variables
YAML_SERIAL_CONSOLE_STDIN:pn-fs-boot ?= "axi_uartlite_0"
YAML_SERIAL_CONSOLE_STDOUT:pn-fs-boot ?= "axi_uartlite_0"
YAML_MAIN_MEMORY_CONFIG:pn-fs-boot ?= "mig_7series_0"
YAML_FLASH_MEMORY_CONFIG:pn-fs-boot ?= ""
XSCTH_PROC:pn-fs-boot ?= "microblaze_0"

# Serial Console Settings
SERIAL_CONSOLES ?= "115200;ttyUL0"
YAML_SERIAL_CONSOLE_BAUDRATE ?= "115200"

# Set DDR Base address for u-boot-xlnx-scr variables
DDR_BASEADDR ?= "0x80000000"
SKIP_APPEND_BASEADDR ?= "0"

# Yocto KERNEL Variables
UBOOT_ENTRYPOINT  ?= "0x80000000"
UBOOT_LOADADDRESS ?= "0x80000000"
KERNEL_EXTRA_ARGS += "UIMAGE_LOADADDR=${UBOOT_ENTRYPOINT}"

# Required generic machine inclusion
require conf/machine/microblaze-generic.conf

# This is an 'XSCT' based BSP
XILINX_XSCT_VERSION = "2024.2"
XILINX_WITH_ESW = "xsct"

# Add system XSA
HDF_URI = "file:///home/tsndetnet/Documents/AmirWorkSpace/MicroblazeYocto/microblaze_100ethernet_ddr3_uart.xsa"
HDF_URI[sha256sum] = "cd56e7792890601a4080737c4465694f5e7e80fa883bd3674e2600c8ff8b9ce2"
HDF_URI[S] = "${WORKDIR}/home/tsndetnet/Documents/AmirWorkSpace/MicroblazeYocto"

#### No additional settings should be after the Postamble
#### Postamble
PACKAGE_EXTRA_ARCHS:append = "${@['', ' microblaze_artix']['microblaze-artix' != '${MACHINE}']}"
```

## Ardu/BackUp_zynq_microblaze_yocto_config/Zynq/build/conf/machine/myd-zturn7020.conf
```bitbake
#@TYPE: Machine
#@NAME: myd-zturn7020
#@DESCRIPTION: Machine configuration for the myd-zturn7020 boards.

#### Preamble
MACHINEOVERRIDES =. "${@['', 'myd-zturn7020:']['myd-zturn7020' !='${MACHINE}']}"
#### Regular settings follow

# Yocto device-tree variables
YAML_CONSOLE_DEVICE_CONFIG:pn-device-tree ?= "ps7_uart_1"
YAML_MAIN_MEMORY_CONFIG:pn-device-tree ?= "ps7_ddr_0"
DT_PADDING_SIZE:pn-device-tree ?= "0x1000"
DTC_FLAGS:pn-device-tree ?= ""
YAML_DT_BOARD_FLAGS ?= "{BOARD template}"

# Yocto u-boot-xlnx variables
UBOOT_MACHINE ?= "xilinx_zynq_virt_defconfig"

# Yocto FSBL variables
YAML_SERIAL_CONSOLE_STDIN:pn-fsbl-firmware ?= "ps7_uart_1"
YAML_SERIAL_CONSOLE_STDOUT:pn-fsbl-firmware ?= "ps7_uart_1"

# Serial Console Settings
SERIAL_CONSOLES ?= "115200;ttyPS0"
YAML_SERIAL_CONSOLE_BAUDRATE ?= "115200"

# Set DDR Base address for u-boot-xlnx-scr variables
DDR_BASEADDR ?= "0x0"
SKIP_APPEND_BASEADDR ?= "0"

# Yocto KERNEL Variables
UBOOT_ENTRYPOINT  ?= "0x200000"
UBOOT_LOADADDRESS ?= "0x200000"
KERNEL_EXTRA_ARGS += "UIMAGE_LOADADDR=${UBOOT_ENTRYPOINT}"

# Required generic machine inclusion
require conf/machine/zynq-generic.conf

# This is an 'XSCT' based BSP
XILINX_XSCT_VERSION = "2024.2"
XILINX_WITH_ESW = "xsct"

# Add system XSA
HDF_URI = "file:///home/tsndetnet/Documents/AmirWorkSpace/TestYoctoXilinx/zynq_ddr3_uart_ethernet_i2c1_i2c2_i2c3.xsa"
HDF_URI[sha256sum] = "8b82f316d33d54951c99f80eac2038606b36375d44f5d259510598c53a24963b"
HDF_URI[S] = "${WORKDIR}/home/tsndetnet/Documents/AmirWorkSpace/TestYoctoXilinx"

#### No additional settings should be after the Postamble
#### Postamble
PACKAGE_EXTRA_ARCHS:append = "${@['', ' myd_zturn7020']['myd-zturn7020' != '${MACHINE}']}"
```

## Ardu/Coraz7s/YoctoStuff/build/conf/local.conf
```bitbake
#MACHINE ??= "zynqmp-generic"
MACHINE = "coraz7"
#MACHINE ??= "myd-zturn7020"

DISTRO ?= "petalinux"
PACKAGE_CLASSES ?= "package_rpm"
USER_CLASSES ?= "buildstats"

LICENSE_CREATE_PACKAGE = "1"
COPY_LIC_MANIFEST = "1"

CONNECTIVITY_CHECK_URIS ?= ""

BB_GENERATE_MIRROR_TARBALLS ?= "1"

PATCHRESOLVE = "noop"

BB_DISKMON_DIRS ??= "\
    STOPTASKS,${TMPDIR},1G,100K \
    STOPTASKS,${DL_DIR},1G,100K \
    STOPTASKS,${SSTATE_DIR},1G,100K \
    STOPTASKS,/tmp,100M,100K \
    HALT,${TMPDIR},100M,1K \
    HALT,${DL_DIR},100M,1K \
    HALT,${SSTATE_DIR},100M,1K \
    HALT,/tmp,10M,1K"

PACKAGECONFIG:append:pn-qemu-system-native = " sdl"
BB_HASHSERVE = ""
BB_SIGNATURE_HANDLER = "OEBasicHash"

PRSERV_HOST = "localhost:0"

LICENSE_FLAGS_ACCEPTED = " \
        commercial_${MLPREFIX}ffmpeg \
        commercial_${MLPREFIX}x264 \
        commercial_${MLPREFIX}gstreamer1.0-omx \
        commercial_${MLPREFIX}libomxil \
        commercial_${MLPREFIX}sox \
        commercial_${MLPREFIX}faac \
        commercial_${MLPREFIX}faad2 \
        xilinx "

CONF_VERSION = "2"

SKIP_META_XILINX_MALI400_SANITY_CHECK = "1"
SKIP_META_XILINX_STANDALONE_SANITY_CHECK = "1"
SKIP_META_XILINX_STANDALONE_SDT_SANITY_CHECK = "1"
SKIP_META_XILINX_TOOLS_SANITY_CHECK = "1"
SKIP_META_VIRT_SANITY_CHECK = "1"
SKIP_META_SECURITY_SANITY_CHECK = "1"
SKIP_META_TPM_SANITY_CHECK = "1"
SKIP_META_GNOME_SANITY_CHECK = "1"
SKIP_META_RAUC_FEATURE_CHECK = "1"


# Fix error of Authentication token manipulation error 
# On Changing password on the first login
EXTRA_IMAGE_FEATURES += "allow-root-login empty-root-password"

# Add Ardupilot copter package
IMAGE_INSTALL:append = " ardupilot"

IMAGE_INSTALL:append = " i2c-tools"
IMAGE_INSTALL:append = " git nano net-tools"


APPEND += " rw"
```

## Ardu/Coraz7s/YoctoStuff/build/conf/machine/coraz7.conf
```bitbake
#@TYPE: Machine
#@NAME: coraz7
#@DESCRIPTION: Machine configuration for the coraz7 boards.

#### Preamble
MACHINEOVERRIDES =. "${@['', 'coraz7:']['coraz7' !='${MACHINE}']}"
#### Regular settings follow

# Yocto device-tree variables
YAML_CONSOLE_DEVICE_CONFIG:pn-device-tree ?= "ps7_uart_0"
YAML_MAIN_MEMORY_CONFIG:pn-device-tree ?= "ps7_ddr_0"
DT_PADDING_SIZE:pn-device-tree ?= "0x1000"
DTC_FLAGS:pn-device-tree ?= ""
YAML_DT_BOARD_FLAGS ?= "{BOARD template}"

# Yocto u-boot-xlnx variables
UBOOT_MACHINE ?= "xilinx_zynq_virt_defconfig"

# Yocto FSBL variables
YAML_SERIAL_CONSOLE_STDIN:pn-fsbl-firmware ?= "ps7_uart_0"
YAML_SERIAL_CONSOLE_STDOUT:pn-fsbl-firmware ?= "ps7_uart_0"

# Serial Console Settings
SERIAL_CONSOLES ?= "115200;ttyPS0"
YAML_SERIAL_CONSOLE_BAUDRATE ?= "115200"

# Set DDR Base address for u-boot-xlnx-scr variables
DDR_BASEADDR ?= "0x0"
SKIP_APPEND_BASEADDR ?= "0"

# Yocto KERNEL Variables
UBOOT_ENTRYPOINT  ?= "0x200000"
UBOOT_LOADADDRESS ?= "0x200000"
KERNEL_EXTRA_ARGS += "UIMAGE_LOADADDR=${UBOOT_ENTRYPOINT}"

# Required generic machine inclusion
require conf/machine/zynq-generic.conf

# This is an 'XSCT' based BSP
XILINX_XSCT_VERSION = "2024.2"
XILINX_WITH_ESW = "xsct"

# Add system XSA
HDF_URI = "file:///home/tsndetnet/Documents/AmirWorkSpace/TestYoctoXilinx/cora_zynq_ddr3_uart1_ethernet_usb_spi1_i2c1.xsa"
HDF_URI[sha256sum] = "72597758392d5633f1d45fb3735e2da28afa1edc3c4cc1869651ae43baae940d"
HDF_URI[S] = "${WORKDIR}/home/tsndetnet/Documents/AmirWorkSpace/TestYoctoXilinx"

#### No additional settings should be after the Postamble
#### Postamble
PACKAGE_EXTRA_ARCHS:append = "${@['', ' coraz7']['coraz7' != '${MACHINE}']}"
```

## Ardu/Coraz7s/YoctoStuff/meta-ardupilot/conf/layer.conf
```bitbake
# We have a conf and classes directory, add to BBPATH
BBPATH .= ":${LAYERDIR}"

# We have recipes-* directories, add to BBFILES
BBFILES += "${LAYERDIR}/recipes-*/*/*.bb \
            ${LAYERDIR}/recipes-*/*/*.bbappend"

BBFILE_COLLECTIONS += "meta-ardupilot"
BBFILE_PATTERN_meta-ardupilot = "^${LAYERDIR}/"
BBFILE_PRIORITY_meta-ardupilot = "6"

LAYERDEPENDS_meta-ardupilot = "core"
LAYERSERIES_COMPAT_meta-ardupilot = "scarthgap"
```

## NXP_RAN/YoctoFiles/build/conf/local.conf
```bitbake
MACHINE ??= 'imx8mp-lpddr4-frdm'
DISTRO ?= 'fsl-imx-xwayland'
EXTRA_IMAGE_FEATURES ?= "allow-empty-password empty-root-password allow-root-login"
USER_CLASSES ?= "buildstats"
PATCHRESOLVE = "noop"
BB_DISKMON_DIRS ??= "\
    STOPTASKS,${TMPDIR},1G,100K \
    STOPTASKS,${DL_DIR},1G,100K \
    STOPTASKS,${SSTATE_DIR},1G,100K \
    STOPTASKS,/tmp,100M,100K \
    HALT,${TMPDIR},100M,1K \
    HALT,${DL_DIR},100M,1K \
    HALT,${SSTATE_DIR},100M,1K \
    HALT,/tmp,10M,1K"
PACKAGECONFIG:append:pn-qemu-system-native = " sdl"
CONF_VERSION = "2"

DL_DIR ?= "${BSPDIR}/downloads/"
ACCEPT_FSL_EULA = "1"



IMAGE_INSTALL:append = " srsran net-tools nano iproute2 openssh-sshd openssh-sftp-server"
IMAGE_FEATURES:append = " ssh-server-openssh"
```

## NXP_RAN/YoctoFiles/meta-srs-ran/conf/layer.conf
```bitbake
# We have a conf and classes directory, add to BBPATH
BBPATH .= ":${LAYERDIR}"

# We have recipes-* directories, add to BBFILES
BBFILES += "${LAYERDIR}/recipes-*/*/*.bb \
            ${LAYERDIR}/recipes-*/*/*.bbappend"

BBFILE_COLLECTIONS += "meta-srs-ran"
BBFILE_PATTERN_meta-srs-ran = "^${LAYERDIR}/"
BBFILE_PRIORITY_meta-srs-ran = "6"

LAYERDEPENDS_meta-srs-ran = "core"
LAYERSERIES_COMPAT_meta-srs-ran = "walnascar"
```

## RPI5/Normal_Version_OpenEB_Drivers_Overlay/build/conf/bblayers.conf
```bitbake
# POKY_BBLAYERS_CONF_VERSION is increased each time build/conf/bblayers.conf
# changes incompatibly
POKY_BBLAYERS_CONF_VERSION = "2"

BBPATH = "${TOPDIR}"
BBFILES ?= ""

BBLAYERS ?= " \
  /home/tsndetnet/Documents/AmirWorkSpace/Rpi5Yocto6_12/poky/meta \
  /home/tsndetnet/Documents/AmirWorkSpace/Rpi5Yocto6_12/poky/meta-poky \
  /home/tsndetnet/Documents/AmirWorkSpace/Rpi5Yocto6_12/poky/meta-yocto-bsp \
  /home/tsndetnet/Documents/AmirWorkSpace/Rpi5Yocto6_12/meta-openembedded/meta-oe \
  /home/tsndetnet/Documents/AmirWorkSpace/Rpi5Yocto6_12/meta-openembedded/meta-python \
  /home/tsndetnet/Documents/AmirWorkSpace/Rpi5Yocto6_12/meta-openembedded/meta-multimedia \
  /home/tsndetnet/Documents/AmirWorkSpace/Rpi5Yocto6_12/meta-openembedded/meta-networking \
  /home/tsndetnet/Documents/AmirWorkSpace/Rpi5Yocto6_12/meta-openembedded/meta-gnome \
  /home/tsndetnet/Documents/AmirWorkSpace/Rpi5Yocto6_12/meta-openembedded/meta-xfce \
  /home/tsndetnet/Documents/AmirWorkSpace/Rpi5Yocto6_12/meta-raspberrypi \
  /home/tsndetnet/Documents/AmirWorkSpace/Rpi5Yocto6_12/meta-openeb \
  "
```

## RPI5/Normal_Version_OpenEB_Drivers_Overlay/build/conf/local.conf
```bitbake
MACHINE = "raspberrypi5"
INIT_MANAGER = "systemd"
LICENSE_FLAGS_ACCEPTED = "synaptics-killswitch"

DISTRO ?= "poky"
#EXTRA_IMAGE_FEATURES ?= "debug-tweaks"

USER_CLASSES ?= "buildstats"

PATCHRESOLVE = "noop"

BB_DISKMON_DIRS ??= "\
    STOPTASKS,${TMPDIR},1G,100K \
    STOPTASKS,${DL_DIR},1G,100K \
    STOPTASKS,${SSTATE_DIR},1G,100K \
    STOPTASKS,/tmp,100M,100K \
    HALT,${TMPDIR},100M,1K \
    HALT,${DL_DIR},100M,1K \
    HALT,${SSTATE_DIR},100M,1K \
    HALT,/tmp,10M,1K"

PACKAGECONFIG:append:pn-qemu-system-native = " sdl"
CONF_VERSION = "2"

PREFERRED_VERSION_linux-raspberrypi = "6.12%"

IMAGE_INSTALL:append = " openeb linux-sensor-drivers genx320-overlay"
IMAGE_INSTALL:append = " i2c-tools"
IMAGE_INSTALL:append = " dtc media-ctl v4l-utils"

IMAGE_INSTALL:append = " git nano net-tools"

IMAGE_INSTALL:append = " openssh-sshd openssh-sftp-server"
IMAGE_FEATURES:append = " ssh-server-openssh"


IMAGE_INSTALL:append = " xserver-xorg xinit xauth xterm twm"

RPI_EXTRA_CONFIG:append = "\ndtoverlay=genx320,cam0"


EXTRA_IMAGE_FEATURES += "allow-root-login empty-root-password"
```

## Yocto_X11_FullOpenGL_PatchedOpenEB_LinuxSensorDriver/build/conf/bblayers.conf
```bitbake
# POKY_BBLAYERS_CONF_VERSION is increased each time build/conf/bblayers.conf
# changes incompatibly
POKY_BBLAYERS_CONF_VERSION = "2"

BBPATH = "${TOPDIR}"
BBFILES ?= ""

BBLAYERS ?= " \
  /home/dell/Documents/AmirWorkSpace/ES_Test_Yocto_Poky_STM32MP2/poky/meta \
  /home/dell/Documents/AmirWorkSpace/ES_Test_Yocto_Poky_STM32MP2/poky/meta-poky \
  /home/dell/Documents/AmirWorkSpace/ES_Test_Yocto_Poky_STM32MP2/poky/meta-yocto-bsp \
  /home/dell/Documents/AmirWorkSpace/ES_Test_Yocto_Poky_STM32MP2/meta-openembedded/meta-oe \
  /home/dell/Documents/AmirWorkSpace/ES_Test_Yocto_Poky_STM32MP2/meta-openembedded/meta-python \
  /home/dell/Documents/AmirWorkSpace/ES_Test_Yocto_Poky_STM32MP2/meta-openembedded/meta-multimedia \
  /home/dell/Documents/AmirWorkSpace/ES_Test_Yocto_Poky_STM32MP2/meta-st-stm32mp \
  /home/dell/Documents/AmirWorkSpace/ES_Test_Yocto_Poky_STM32MP2/meta-openembedded/meta-networking \
  /home/dell/Documents/AmirWorkSpace/ES_Test_Yocto_Poky_STM32MP2/meta-openembedded/meta-gnome \
  /home/dell/Documents/AmirWorkSpace/ES_Test_Yocto_Poky_STM32MP2/meta-openembedded/meta-xfce \
  /home/dell/Documents/AmirWorkSpace/ES_Test_Yocto_Poky_STM32MP2/meta-openeb \
  "
```
